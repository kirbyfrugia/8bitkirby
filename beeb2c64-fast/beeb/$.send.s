  ORG $1900

zpb0     EQU $70
zpb1     EQU $71
zpb2     EQU $72
zpb3     EQU $73
newl     EQU $ffe7
osbyte   EQU $fff4
oswrch   EQU $ffee
osrdch   EQU $ffe0
osword   EQU $fff1
osfind   EQU $ffce
osbget   EQU $ffd7

main
  ; make sure we are in screen out
  LDA #3
  LDX #4
  JSR osbyte

  LDA #>fname.input
  STA zpb0
  LDA #<fname.input
  STA zpb1
  JSR printstr

  ; read in string
  LDA #>fname
  STA fname.params
  LDA #<fname
  STA fname.params+1
  LDA #0
  LDX #>fname.params
  LDY #<fname.params

  JSR osword
  BCC fname.noesc
  JMP done

fname.noesc
  LDA #>fname.msg
  STA zpb0
  LDA #<fname.msg
  STA zpb1
  JSR printstr

  LDA #>fname
  STA zpb0
  TAX
  LDA #<fname
  STA zpb1
  TAY
  JSR printstr

  JSR newl

  ; open file
  LDA #$40
  JSR osfind
  BEQ file.open.err
  STA fileid
  JMP file.open.noerr

file.open.err
  LDA #>file.err.msg
  STA zpb0
  LDA #<file.err.msg
  STA zpb1
  JSR printstr
  JSR newl
  JMP done

file.open.noerr
  JSR get.baud
  LDX baud
  CPX #$1b ; escape
  BNE baud.noesc
  JMP done
baud.noesc

  ; set baud
  LDA #7
  LDX baud
  JSR osbyte
  LDA #8
  LDX baud
  JSR osbyte

  ; rs423 in
  LDA #2
  LDX #1
  JSR osbyte

next.packet
  ; flush buffer
  LDA #15
  LDX #1
  JSR osbyte 

  ; enable rs423 out
  LDA #3
  LDX #7
  JSR osbyte

  LDA #0
  STA sumlo
  STA sumhi
  TAX
next.byte
  LDA retrying
  BNE byte.read

  LDA packet,x
  JMP byte.loaded
byte.read
  LDA eof
  BEQ byte.pad

  ; read byte from file
  LDY fileid
  JSR osbget
  BCC byte.byteread

  LDA #0
  STA eof
  BEQ byte.pad

byte.byteread
  STA packet,x
  JMP byte.loaded
byte.pad
  ; pad in empty byte char
  LDA #26
  STA packet,x
byte.loaded
  PHA
  CLC
  ADC sumlo
  STA sumlo
  BCC byte.send
  INC sumhi
byte.send
  PLA

  ; send byte
  JSR oswrch

  INX
  CPX #128
  BNE next.byte

  ; send checksum lo
  LDA sumlo
  EOR #$ff
  JSR oswrch

  ; send checksum hi
  LDA sumhi
  EOR #$ff
  JSR oswrch

  ; screen out  
  LDA #3
  LDX #4
  JSR osbyte

  LDA #46 ; "."
  JSR oswrch

  ; await reply up to 5 seconds
  LDA #129
  LDX #244
  LDY #1
  JSR osbyte
  BCS reply.err
  TXA

  CMP #65
  BEQ acked
  ; anything other than "A",retry
  JSR oswrch
  LDA #0
  STA retrying
  JMP next.packet

acked
  JSR oswrch
  LDA eof
  BEQ close

  LDA #1
  STA retrying
  JMP next.packet
reply.err
  CPY #$1b ; escape hit
  BNE timeout
  LDA #$7e ; ack escape
  JSR osbyte
  JMP close
timeout
  JSR newl
  LDA #>timeout.str
  STA zpb0
  LDA #<timeout.str
  STA zpb1
  JSR printstr
close
  ; close file
  LDA #0
  LDY fileid
  JSR osfind

done
  JSR newl

  LDA #>done.str
  STA zpb0
  LDA #<done.str
  STA zpb1
  JSR printstr

  JSR newl

  ; keyboard in
  LDA #2
  LDX #0
  JSR osbyte

  RTS


get.baud
  PHA
get.baud.loop
  LDA #>baud.str
  STA zpb0
  LDA #<baud.str
  STA zpb1
  JSR printstr

  ; flush buffer
  LDA #15
  LDX #1
  JSR osbyte

  JSR osrdch
  CMP #$1B ; escape
  BEQ baud.esc

  CMP #51
  BEQ baud.valid
  CMP #52
  BEQ baud.valid
  CMP #55
  BEQ baud.valid
  CMP #56
  BEQ baud.valid
  JSR newl
  JMP get.baud.loop

baud.valid
  SEC
  SBC #48
  STA baud
  JMP get.baud.done
baud.esc
  STA baud
  ; ack the escape
  LDA #$7e
  JSR osbyte

get.baud.done
  JSR newl
  PLA
  RTS

printstr
  PHA
  TYA
  PHA

  LDY #0
printstr.loop
  LDA (zpb0),y
  BEQ printstr.done
  CMP #$0d ; carriage return
  BEQ printstr.done
  JSR oswrch
  INY
  JMP printstr.loop
printstr.done
  PLA
  TAY
  PLA
  RTS
 
fileid        DFB 0
eof           DFB 1
sumlo         DFB 0
sumhi         DFB 0
retrying      DFB 1
baud          DFB 8
fname         DS 20
fname.params  DFB 0,0,10,33,191
packet        DS 130  
fname.input   ASC "Enter file name: "
  DFB 0
fname.msg     ASC "Sending file: "
  DFB 0
file.err.msg  ASC "Error opening file"
  DFB 0
baud.str      ASC "Baud (3=300,4=1200,7=9600,8=19200): "
  DFB 0
done.str      ASC "Done"
  DFB 0
timeout.str   ASC "Timeout"
  DFB 0